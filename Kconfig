## Kconfig
```kconfig
menu "HTTP Client Configuration"

    config HTTP_CLIENT_URI_GET
        string "Server URI GET"
        default "http://httpbin.org/get"
        help
            Server uri get for the example to use. 

    config HTTP_CLIENT_URI_POST
        string "Server URI POST"
        default "http://httpbin.org/post"
        help
            Server uri post for the example to use. 

    config HTTP_CLIENT_URI_IMAGE
        string "Image URI"
        default "http://httpbin.org/image/jpeg"
        help
            Server uri for image reader.

endmenu
```
